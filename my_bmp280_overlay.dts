/dts-v1/;
/plugin/;

/ {
    compatible = "ti,am335x-bone-black";

    fragment@0 {
        target = <&i2c2>;
        __overlay__ {
            #address-cells = <1>;
            #size-cells = <0>;

            my_sensor@76 {
                compatible = "custom,my-sensor";
                reg = <0x76>;
                status = "okay";
                interrupt-parent = <&gpio1>;
                interrupts = <12 IRQ_TYPE_EDGE_FALLING>;
            };
        };
    };
};